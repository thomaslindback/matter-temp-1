## main/Kconfig.projbuild
```kconfig
menu "TEMP-1 Configuration"

    config I2C_MASTER_SDA
        int "I2C SDA Pin"
        default 4
        help
            GPIO number for I2C master data

    config I2C_MASTER_SCL
        int "I2C SCL Pin"
        default 5
        help
            GPIO number for I2C master clock

    config RESET_BUTTON_PIN
        int "Reset button Pin"
        default 6
        help
            GPO number for Reset button
endmenu
```
